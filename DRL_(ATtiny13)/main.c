	/**********************************************************************************************
	*                                                                                             *
	*           Дневные ходовые огни на Hyundai Sonata EF (дальний в четверть накала)             *
	*                                                                                             *
	*                                   ATtiny13A     0.6 MHz                                     *
	*                                                                                             *
	**********************************************************************************************/


	/**********************************************************************************************
	*                              ОБЪЯВЛЕНИЕ ПЕРЕМЕННЫХ И ФУНКЦИЙ                                *
	**********************************************************************************************/

#include <avr/io.h>
#include <avr/interrupt.h>
#include <avr/eeprom.h>

#define LAMP                0                 // лампа на пине PB0
#define BTN_1               1                 // кнопка_1 на пине PB1
#define BTN_2               2                 // кнопка_2 на пине PB2
#define Control_M           3                 // управление минусом PB3
#define Control_P           4                 // управление плюсом PB4
#define Light_Duty_Def      64                // скважность по умолчанию
#define Time_Smooth         2                 // время плавного розжига
#define _Smooth_is_need     0                 // флаг потребности плавного розжига
#define _DRL_started        1                 // флаг работающего ДХО

unsigned char     Flag_Byte       = 0;
unsigned char     Count_Time      = 0;
unsigned char     Light_Duty;                 // скважность
uint8_t   EEMEM   Light_Duty_1_EE;
uint8_t   EEMEM   Light_Duty_2_EE;

void Presets(void);
void SmoothIgnition(void);
void StartDRL(void);
void StopDRL(void);
void LoadData(void);
void SaveData(void);


	/**********************************************************************************************
	*                                     ОСНОВНАЯ ФУНКЦИЯ                                        *
	**********************************************************************************************/

int main (void)
{
	Presets();

	while (1)
	{
    if (~PINB & (1<<Control_M))                           // если на пине "0" - ВКЛЮЧЕНИЕ
    {
      if (~Flag_Byte & (1<<_DRL_started))                 // если ДХО вЫключено
      {
        StartDRL();
      }
      
      if (Flag_Byte & (1<<_Smooth_is_need))               // если нужен плавный розжиг
      {
        SmoothIgnition();
      }
    }
    else                                                  // если на пине "1" - ВЫКЛЮЧЕНИЕ
    {
      if (Flag_Byte & (1<<_DRL_started))
      {
        StopDRL();
      }
    }
    
		asm("nop");
	}
}


	/**********************************************************************************************
	*                                    ОСТАЛЬНЫЕ ФУНКЦИИ                                        *
	**********************************************************************************************/

		/*-------------------------------- Предустановки ------------------------------------*/

void Presets (void)
{
  DDRB      |=  (1<<LAMP);
  DDRB      &=~ ((1<<BTN_1) | (1<<BTN_2) / (1<<Control_M) | (1<<Control_P));
  PORTB     |=  (1<<BTN_1) | (1<<BTN_2) | (1<<Control_M);
  PORTB     &=~ (1<<Control_P);
  Flag_Byte |=  (1<<_Smooth_is_need);                         // включение плавного розжига
    
//  TCCR0B    &=~ ((1<<CS02) | (1<<CS01) | (1<<CS00));          // выключение тайера-счетчика
  TCCR0A 	  |= 	(1<<WGM00) | (1<<WGM01);	                    // выбор режима работы таймера (табл. 11.8 стр. 73)			  Fast PWM (3)
//  TCCR0A	  |=	(1<<COM0A1);				                          // подключение пина OC0A (PB0) к выходу ШИМ-генератора
  TIMSK0    |=  (1<<TOIE0);                                   // включение прерываний по переполнению счетчика
  OCR0A 	  =   1;			                                      // начальное значение для счетчика (11.9.4 стр. 75)        (скважность)
  
  LoadData();
  
  asm ("sei");                                                // разрешение прерываний (стр. 161)
}

    /*------------------------------- Плавный розжиг -----------------------------------*/

void SmoothIgnition (void)
{
  if (Count_Time >= 6)                                        // 3.4ms * 6 = 20ms (тайминг для инкремента скважности)
  {
    if (OCR0A < Light_Duty)                                   // если скважность еще не достигла своего уровня
    {
      OCR0A++;                                                // увеличение скважности
      Count_Time = 0;
    }
    else                                                      // если скважность достигла своего уровня
    {
      Count_Time = 0;
      Flag_Byte &=~ (1<<_Smooth_is_need);                     // остановка плавного розжига
    }
  } 
}

    /*-------------------------------- Включение ДХО ------------------------------------*/

void StartDRL(void)
{
  asm ("cli");
  Flag_Byte |=  (1<<_DRL_started);                            // установка флага включенного ДХО
  TCCR0B 	|=	(1<<CS01);                                      // установка предделителя таймера (табл. 11.9 стр. 74) 	  8 (0.6 MHz/256/8=293 Hz (3.4 ms))
  TCCR0A	|=	(1<<COM0A1);                                    // подключение пина OC0A (PB0) к выходу ШИМ-генератора
  asm ("sei");
} 

    /*-------------------------------- Выключение ДХО -----------------------------------*/

void StopDRL(void)
{
  asm ("cli");
  Flag_Byte &=~ (1<<_DRL_started);                            // сброс флага включенного ДХО
  TCCR0B    &=~ ((1<<CS02) | (1<<CS01) | (1<<CS00));          // выключение тайера-счетчика
  TCCR0A	  &=~	(1<<COM0A1);                                  // отключение пина OC0A (PB0) от выхода ШИМ-генератора
  PORTB     &=~ (1<<LAMP);                                    // выключение порта выхода на лампы
  OCR0A     =   1;                                            // начальное значение для счетчика (для плавного розжига)
  Flag_Byte |=  (1<<_Smooth_is_need);                         // включение плавного розжига (для последующего включения)
  asm ("sei");
}

    /*------------------------------- Загрузка данных -----------------------------------*/

void LoadData(void)
{
  if (eeprom_read_byte(& Light_Duty_1_EE) == eeprom_read_byte(& Light_Duty_2_EE))   // если значения в 2-х ячейках совпадают
  {
    Light_Duty = eeprom_read_byte(& Light_Duty_1_EE);         // чтение из памяти сохраненного значения скважности
  }
  else                                                        // если произошел сбой и в ячейках разные данные
  {
    eeprom_write_byte(& Light_Duty_1_EE, Light_Duty_Def);     // запись в ячейки предустановленного значения
    eeprom_write_byte(& Light_Duty_2_EE, Light_Duty_Def);
  }
}

    /*------------------------------ Сохранение данных ----------------------------------*/

void SaveData(void)
{
  
}


	/**********************************************************************************************
	*                                         ПРЕРЫВАНИЯ                                          *
	**********************************************************************************************/

		/*------------------------- По изменению состояния пинов ----------------------------*/
/*
ISR (PCINT0_vect)															                // 
{
	
}
*/
		/*--------------------------- По переполнению счетчика ------------------------------*/

ISR (TIM0_OVF_vect)													                  // каждые 3.4 мс
{
  Count_Time++;
}